## CMakeLists.txt
```
cmake_minimum_required(VERSION 3.8.2)
set_property(GLOBAL PROPERTY CSTD c11)

macro(set_conf_file)
  if(EXISTS ${APPLICATION_SOURCE_DIR}/prj_${BOARD}.conf)
    set(CONF_FILE "${APPLICATION_SOURCE_DIR}/prj_${BOARD}.conf")
  elseif(EXISTS ${APPLICATION_SOURCE_DIR}/boards/${BOARD}.conf)
    set(CONF_FILE
      "prj.conf ${APPLICATION_SOURCE_DIR}/boards/${BOARD}.conf")
  else()
    set(CONF_FILE "prj.conf")
  endif()
endmacro()

include($ENV{ZEPHYR_BASE}/cmake/app/boilerplate.cmake NO_POLICY_SCOPE)
project(otg2)

enable_language(C ASM)

set(CMAKE_C_FLAGS "${CMAKE_C_FLAGS} \
 -DARM_MATH_CM4 \
 -DDISABLE_FLOAT_API \
 -DFIXED_POINT \
 -DUSE_ALLOCA \
 -DHAVE_LRINT \
 -DHAVE_LRINTF \
 -DOPUS_ARM_ASM \
 -DOPUS_ARM_INLINE_EDSP \
 -DOPUS_ARM_INLINE_MEDIA \
 -DOPUS_ARM_MAY_HAVE_EDSP \
 -DOPUS_ARM_PRESUME_EDSP \
 -DCUSTOM_SUPPORT \
 -DVAR_ARRAYS \
 -DOPUS_BUILD \
 -DHAVE_CONFIG_H \
 -g \
")
# -DOVERRIDE_OPUS_ALLOC -DOVERRIDE_OPUS_FREE -D'opus_alloc(x)=NULL' -D'opus_free(x)=NULL' \

# Use DOPUS_ARM_INLINE_EDSP instead of
# -DOPUS_ARM_INLINE_ASM \

# Not if use minimal lib
# -DHAVE_ALLOCA_H \



target_sources(                     app PRIVATE src/main.c)


FILE(GLOB_RECURSE audio_sources src/audio/*.c)
FILE(GLOB_RECURSE radio_sources src/radio/*.c)
FILE(GLOB_RECURSE oled_sources src/oled/*.c)


target_sources(app PRIVATE
	${audio_sources}
	src/audio/opus-1.2.1/arm/celt_pitch_xcorr_arm_gcc.s
	${radio_sources}
	${oled_sources}
	)


zephyr_include_directories(
	src/
	src/audio/
	src/audio/opus-1.2.1/
	src/audio/sgtl5000/
	src/radio/
	src/oled/
	)

include($ENV{ZEPHYR_BASE}/samples/net/common/common.cmake)
```

## Kconfig
```
# Kconfig - Private config options for echo-server sample app

#
# Copyright (c) 2018 Intel Corporation
#
# SPDX-License-Identifier: Apache-2.0
#

mainmenu "Audio demo sample application"

config AUDIO_CODEC_SGTL5000
	bool "Use I2S audio codec SGTL5000"
	default n
	help
	  SGTL5000 is an HW I2S audio codec.


config AUDIO_CODEC_RECORDER
	bool "Audio type : recorder"
	default n
	help
	  Select if type is recorder ? else is streamer.



source "Kconfig.zephyr"
```

## prj.conf
```kconfig
CONFIG_SYS_CLOCK_TICKS_PER_SEC=1000



# Kernel options
CONFIG_ENTROPY_GENERATOR=y
CONFIG_INIT_STACKS=y

#
# ARM Options
#
CONFIG_ARM_STACK_PROTECTION=y


#
# ARM Cortex-M0/M0+/M3/M4/M7/M23/M33 options
#
CONFIG_MPU_STACK_GUARD=y


#
# General Architecture Options
#

CONFIG_HW_STACK_PROTECTION=y

#
# Bluetooth
#
# CONFIG_BT is not set

#
# General Kernel Options
#
#CONFIG_MAIN_STACK_SIZE=1024

#
# Kernel Debugging and Metrics
#
CONFIG_THREAD_MONITOR=y
CONFIG_THREAD_NAME=y

#
# Shell Options
#
#CONFIG_SHELL=y
#CONFIG_SHELL_BACKENDS=y
#CONFIG_SHELL_BACKEND_SERIAL=y

#CONFIG_SHELL_CMDS=y
#CONFIG_SHELL_CMDS_RESIZE=y
#CONFIG_SHELL_LOG_BACKEND=y
#CONFIG_KERNEL_SHELL=y
#CONFIG_DEVICE_SHELL=y


#
# C Library
#
CONFIG_NEWLIB_LIBC=y
CONFIG_STDOUT_CONSOLE=y

#
# Logging Options
#
CONFIG_LOG=y


#
# Debugging Options
#
CONFIG_DEBUG=y
CONFIG_STACK_USAGE=y
CONFIG_STACK_SENTINEL=y
CONFIG_PRINTK=y
CONFIG_ASSERT=y
CONFIG_ASSERT_LEVEL=2
CONFIG_OPENOCD_SUPPORT=y


#
# Compiler Options
#
#CONFIG_SIZE_OPTIMIZATIONS=y
#CONFIG_SPEED_OPTIMIZATIONS=y
CONFIG_DEBUG_OPTIMIZATIONS=y
#CONFIG_COMPILER_OPT="-g"
```

## overlay-audio.conf
```kconfig
##################################
#radio 
##################################


CONFIG_ENTROPY_GENERATOR=y
CONFIG_SOC_COMPATIBLE_NRF=y
CONFIG_ENTROPY_HAS_DRIVER=y
```

## overlay-audio_recorder.conf
```kconfig
CONFIG_AUDIO_CODEC_RECORDER=y
```

## overlay-cpustats.conf
```kconfig
CONFIG_TRACING=y
CONFIG_TRACING_CPU_STATS=y
CONFIG_TRACING_CPU_STATS_LOG=y
CONFIG_TRACING_CPU_STATS_INTERVAL=2000
```

## overlay-oled.conf
```kconfig
CONFIG_SPI_1=y
CONFIG_GPIO=y
CONFIG_SPI=y
CONFIG_HAS_DTS_GPIO=y
CONFIG_HAS_DTS_SPI=y

CONFIG_GPIO_NRFX=y
CONFIG_GPIO_NRF_INIT_PRIORITY=40
CONFIG_GPIO_NRF_P0=y
CONFIG_GPIO_NRF_P1=y

#CONFIG_SPI_INIT_PRIORITY=70
CONFIG_SPI_1_OP_MODES=1
CONFIG_SPI_NRFX=y
CONFIG_SPI_1_NRF_SPIM=y
#CONFIG_SPI_1_NRF_ORC=0xff
#CONFIG_SPI_NRFX_RAM_BUFFER_SIZE=0


CONFIG_NRFX_SPIM=y
```

## overlay-sgtl5000.conf
```kconfig
#CONFIG_AUDIO_CODEC_SGTL5000=y

CONFIG_I2C_0=y
CONFIG_HAS_DTS_I2C=y
CONFIG_I2C=y
CONFIG_I2C_NRFX=y
CONFIG_I2C_0_NRF_TWI=y
CONFIG_NRFX_TWI=y
CONFIG_NRFX_I2S=y
```

## src/main.c
```c
/*
 * main.c
 *
 *  Created on: 12 mars 2019
 *      Author: nlantz
 */


#include <zephyr.h>
#include <stdio.h>
#include <version.h>

#include <logging/log.h>
LOG_MODULE_REGISTER(main, LOG_LEVEL_DBG);

#include "nrf52_api_def.h"

#include "radio_task.h"
#include "audio_server.h"


#define STATS_PERIOD_MS 10000

static void stats_print(struct k_timer *timer_id);
K_TIMER_DEFINE(stats_timer, stats_print, NULL);


static struct k_sem quit_lock;

void quit(void)
{
	LOG_ERR("quit");
	k_sem_give(&quit_lock);
}


void panic(const char *msg)
{
	if (msg) {
		LOG_ERR("%s", msg);
	}

	for (;;) {
		k_sleep(K_FOREVER);
	}
}


static void stats_print(struct k_timer *timer_id)
{
	radio_stats_print();
	audio_stats_print();
}

void main(void)
{
	//From /otg2@otg2/zephyr/include/generated/autoconf.h
	LOG_INF("-- Zephyr   : %s ",KERNEL_VERSION_STRING);
	LOG_INF("-- Board    : %s", CONFIG_BOARD);
	LOG_INF("-- Compiled : %s %s --", __DATE__, __TIME__);

	LOG_INF("Starting...");
	k_sem_init(&quit_lock, 0, UINT_MAX);

#if 1
	//Init Radio Interface
	radio_Init();
	//Set Mode
	radio_SelectMode(MODE_NORMAL_OPERATION);
#endif

#if 1
	audio_server_init();
#endif

#if 0
	oled_test();
#endif

	//Start stats
	k_timer_start(&stats_timer, STATS_PERIOD_MS, STATS_PERIOD_MS);

	LOG_INF("wait App End...");
	k_sem_take(&quit_lock, K_FOREVER);
	LOG_INF("Stopping...");

	audio_server_stop();
}
```
